## minimal/main/Kconfig.projbuild
```kconfig
menu "Mitr ESP32 Device"
    config MITR_TRANSPORT_PIPECAT_GATEWAY
        bool
        default y

    config MITR_GATEWAY_WS_URL
        string "Pipecat gateway WebSocket URL"
        default ""
        help
            WebSocket URL for the Pipecat gateway. Set this in local/prod
            sdkconfig; do not ship production firmware with an empty value.

    config MITR_CODEC_BOARD_TYPE
        string "Codec board type"
        default "MITR_ESP32_S3_RAW_I2S"
        help
            Supported codec board identifier from the codec_board component.
            Defaults to the raw I2S wiring used by the Mitr ESP32-S3-WROOM
            bring-up board. Change this only when targeting different hardware.

    config MITR_SPEAKER_VOLUME
        int "Default speaker volume (0-100%)"
        default 100
        range 0 100
        help
            Initial output volume used by the local speaker renderer.

    config MITR_WIFI_SSID
        string "Wi-Fi SSID"
        default ""
        help
            Optional static Wi-Fi SSID for local firmware testing. Leave empty
            to use stored/provisioned Wi-Fi credentials.

    config MITR_WIFI_PASSWORD
        string "Wi-Fi password"
        default ""
        help
            Password for the static Wi-Fi SSID. Leave empty for open networks
            or when using stored/provisioned credentials.

    config MITR_NETWORK_MAX_RETRIES
        int "Wi-Fi max reconnect retries"
        default -1
        help
            Maximum Wi-Fi reconnect attempts before surfacing connection
            failure. Use -1 to keep retrying.

    config MITR_DEVICE_BACKEND_BASE_URL
        string "Mitr backend base URL"
        default ""
        help
            Backend API base URL. Use the backend's LAN IP for local testing;
            production firmware must use an HTTPS origin.

    config MITR_DEVICE_DEVICE_ID
        string "Device ID"
        default ""
        help
            Stable hardware identity printed in the device QR code. Set this
            per device; do not ship a shared default identifier.

    config MITR_DEVICE_ACCESS_TOKEN
        string "Device access token"
        default ""
        help
            Long-lived credential returned by POST /devices/claim/complete.
            The device uses this bearer token for the Pipecat gateway websocket
            and to send heartbeat/telemetry.

    config MITR_DEVICE_PAIRING_TOKEN
        string "One-time pairing token"
        default ""
        help
            Short-lived bootstrap token returned by POST /devices/pairing/start.
            The device exchanges this once with POST /devices/bootstrap/complete
            to receive the long-lived device access token that is then stored.

    config MITR_DEVICE_LANGUAGE
        string "Preferred language"
        default "hi-IN"
        help
            Sent to the Pipecat gateway so the backend can select the right
            locale.

    config MITR_DEVICE_HARDWARE_REV
        string "Hardware revision"
        default "esp32-s3-wroom"
        help
            Hardware revision string persisted in backend sessions and firmware
            rollout targeting.

    config MITR_DEVICE_FIRMWARE_VERSION
        string "Firmware version"
        default "v0.1.0-dev"
        help
            Current firmware version reported during token minting and heartbeat.

    config MITR_DEVICE_HEARTBEAT_INTERVAL_SEC
        int "Heartbeat interval (seconds)"
        default 15
        range 5 300
        help
            How often the device reports liveness to POST /devices/heartbeat
            while the session remains active.

    config MITR_MIC_INPUT_CHANNEL
        int "Primary microphone I2S channel: 0=left, 1=right"
        default 0
        range 0 1
        help
            INMP441 selects its active I2S slot with the L/R pin. L/R tied to
            GND uses left/channel 0; L/R tied to VDD uses right/channel 1.

    config MITR_MIC_INPUT_BITS
        int "Primary microphone I2S bits per sample"
        default 32
        range 16 32
        help
            INMP441 outputs 24-bit audio in a 32-bit I2S slot, so production
            capture should request 32-bit input and down-convert to 16-bit PCM.

    config MITR_MIC_INPUT_SHIFT
        int "Primary microphone 32-bit to 16-bit right shift"
        default 16
        range 8 24
        help
            Right shift used when converting 32-bit I2S microphone samples to
            signed 16-bit PCM for the Pipecat gateway.

    config MITR_MIC_LOOPBACK_PROBE
        bool "Run mic loopback probe instead of normal app"
        default n
        help
            Debug-only mode. On boot, routes the selected microphone channel
            directly to the speaker so raw I2S channel selection can be tested
            by ear without the Pipecat gateway in the path.

    config MITR_MIC_LOOPBACK_CHANNEL
        int "Mic loopback channel: 0=left, 1=right, 2=stereo"
        default 0
        range 0 2
        depends on MITR_MIC_LOOPBACK_PROBE
        help
            Selects which I2S RX channel to play back in loopback probe mode.
            Left/right are selected by the codec driver channel mask and are
            duplicated to both speaker channels.

    config MITR_MIC_LOOPBACK_VOLUME
        int "Mic loopback speaker volume"
        default 55
        range 0 100
        depends on MITR_MIC_LOOPBACK_PROBE
        help
            Speaker volume for loopback probe mode. Keep this moderate to
            reduce acoustic feedback while testing.

    config MITR_MIC_LOOPBACK_BITS
        int "Mic loopback input bits per sample"
        default 16
        range 16 32
        depends on MITR_MIC_LOOPBACK_PROBE
        help
            I2S RX data width to request from the codec driver. Use 32 for
            common I2S MEMS microphones that output 24-bit samples in 32-bit
            slots.

    config MITR_MIC_LOOPBACK_SHIFT
        int "Mic loopback 32-bit to 16-bit right shift"
        default 16
        range 8 24
        depends on MITR_MIC_LOOPBACK_PROBE
        help
            Right shift applied when loopback input bits are 32. Try 16 first;
            lower values are louder and may clip.
endmenu
```

## minimal/sdkconfig.defaults
```kconfig
CONFIG_IDF_TARGET="esp32s3"
CONFIG_LK_EXAMPLE_CODEC_BOARD_TYPE="DUMMY_CODEC_BOARD"
CONFIG_LK_EXAMPLE_SPEAKER_VOLUME=85
CONFIG_MITR_DEVICE_LANGUAGE="hi-IN"
CONFIG_MITR_DEVICE_HARDWARE_REV="esp32-s3-wroom"
CONFIG_MITR_DEVICE_FIRMWARE_VERSION="v0.1.0-dev"

CONFIG_CODEC_I2C_BACKWARD_COMPATIBLE=n
CONFIG_COMPILER_OPTIMIZATION_PERF=y
CONFIG_ESP_DEFAULT_CPU_FREQ_MHZ_240=y
CONFIG_ESP_WS_CLIENT_ENABLE_DYNAMIC_BUFFER=y
CONFIG_ESP_WS_CLIENT_SEPARATE_TX_LOCK=y
CONFIG_ESP32S3_DATA_CACHE_64KB=y
CONFIG_ESP32S3_DATA_CACHE_LINE_64B=y
CONFIG_ESP32S3_INSTRUCTION_CACHE_32KB=y
CONFIG_ESPTOOLPY_FLASHMODE_QIO=y
CONFIG_ESPTOOLPY_FLASHSIZE_16MB=y
CONFIG_FREERTOS_HZ=1000
CONFIG_FREERTOS_TIMER_TASK_STACK_DEPTH=4096
CONFIG_IDF_EXPERIMENTAL_FEATURES=y
CONFIG_LWIP_SNTP_MAX_SERVERS=2
CONFIG_MBEDTLS_CERTIFICATE_BUNDLE=y
CONFIG_MBEDTLS_EXTERNAL_MEM_ALLOC=y
CONFIG_MBEDTLS_SSL_DTLS_SRTP=y
CONFIG_MBEDTLS_SSL_PROTO_DTLS=y
CONFIG_PARTITION_TABLE_CUSTOM=y
```

## minimal/sdkconfig.defaults.gateway
```kconfig
CONFIG_MITR_TRANSPORT_PIPECAT_GATEWAY=y
CONFIG_MITR_GATEWAY_WS_URL="ws://127.0.0.1:7860/ws"
CONFIG_MITR_WIFI_SSID=""
CONFIG_MITR_WIFI_PASSWORD=""
```
